## Documentation/devicetree/bindings/media/i2c/sony,imx577.yaml
```yaml
# SPDX-License-Identifier: (GPL-2.0-only OR BSD-2-Clause)
%YAML 1.2
---
$id: http://devicetree.org/schemas/media/i2c/sony,imx577.yaml#
$schema: http://devicetree.org/meta-schemas/core.yaml#

title: Sony 1/2.3-Inch 12Mpixel CMOS Digital Image Sensor

maintainers:
  - Yu Dukai <646689853@qq.com>

description: |-
  The Sony IMX577 is a 1/2.3-inch CMOS active pixel digital image sensor
  with an active array size of 4056H x 3040V. It is programmable through an
  I2C interface. The I2C address is 0x1A as per the sensor data sheet, some
  third party modules use 0x10 instead. Image data is sent through MIPI
  CSI-2, which can be configured with two or four data lanes.

properties:
  compatible:
    const: sony,imx577

  reg:
    description: I2C device address
    maxItems: 1

  clocks:
    maxItems: 1

  clock-names:
    const: xclk

  VDIG-supply:
    description:
      Digital I/O voltage supply, 1.05 volts

  VANA-supply:
    description:
      Analog voltage supply, 2.8 volts

  VDDL-supply:
    description:
      Digital core voltage supply, 1.8 volts

  reset-gpios:
    description: |-
      Reference to the GPIO connected to the XCLR pin, if any.
      The sensor is held in reset while the line is low and must be released
      (set high) after all supplies and INCK are applied.

  port:
    $ref: /schemas/graph.yaml#/$defs/port-base

    properties:
      endpoint:
        $ref: /schemas/media/video-interfaces.yaml#
        unevaluatedProperties: false

        properties:
          data-lanes:
            description: |-
              The sensor supports two and four lane operation.  With fewer
              than four lanes the line length is scaled so that the sensor
              output rate matches the CSI-2 link rate.
            anyOf:
              - items:
                  - const: 1
                  - const: 2
              - items:
                  - const: 1
                  - const: 2
                  - const: 3
                  - const: 4

          clock-noncontinuous: true

          link-frequencies: true

        required:
          - data-lanes
          - link-frequencies

    required:
      - endpoint

required:
  - compatible
  - reg
  - clocks
  - VANA-supply
  - VDIG-supply
  - VDDL-supply
  - port

additionalProperties: false

examples:
  - |
    i2c {
        #address-cells = <1>;
        #size-cells = <0>;

        imx577: sensor@1a {
            compatible = "sony,imx577";
            reg = <0x1a>;
            clocks = <&imx577_clk>;
            clock-names = "xclk";
            VANA-supply = <&imx577_vana>;   /* 2.8v */
            VDIG-supply = <&imx577_vdig>;   /* 1.05v */
            VDDL-supply = <&imx577_vddl>;   /* 1.8v */
            reset-gpios = <&gpio 22 GPIO_ACTIVE_HIGH>;

            port {
                imx577_0: endpoint {
                    remote-endpoint = <&csi1_ep>;
                    data-lanes = <1 2 3 4>;
                    clock-noncontinuous;
                    link-frequencies = /bits/ 64 <750000000>;
                };
            };
        };
    };

...
```
